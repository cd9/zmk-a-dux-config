## config/west.yml
```yaml
manifest:
  remotes:
    - name: zmkfirmware
      url-base: https://github.com/zmkfirmware
    - name: cd9
      url-base: https://github.com/cd9
  projects:
    - name: zmk
      remote: cd9
      revision: mouse-pr
      import: app/west.yml
  self:
    path: config
```
